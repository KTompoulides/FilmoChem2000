#include <Adafruit_SH110X.h>
#include <SPI.h>
#include <OneWire.h>
#include <DallasTemperature.h>

#define OLED_MOSI   11 //blue
#define OLED_CLK   12 //yellow
#define OLED_DC    8 //green
#define OLED_CS    10 //orange
#define OLED_RESET 9 //white
#define HEATER 4
#define PUMP 2
#define BUZZER 3


float chemATemp,chemBTemp,waterTemp; 
int curMenu = 0;

float maxTempVariation = 0.4;
int i = 0 ;
bool reverse = false;
uint8_t sensor1[8] = {0x28, 0x80, 0xD6, 0x3A, 0x01, 0x21, 0x0A, 0xB5}; //sensor address
uint8_t sensor2[8] ={0x28, 0x28, 0x79, 0x43, 0x01, 0x21, 0x0A, 0x2F};
uint8_t sensor3[8] ={0x28, 0x45, 0xA6, 0x75, 0xD0, 0x01, 0x3C, 0xC6};
   


OneWire oneWire(7);
DallasTemperature sensors(&oneWire);

//startup logo
const unsigned char filmochem_bmp [] PROGMEM ={
0x00, 0x00, 0x00, 0x00, 0x00, 0x01, 0x00, 0x00, 0x00, 0x00, 0x00, 0x00, 0x00, 0x00, 0x00, 0x00,
0x00, 0x00, 0x00, 0x00, 0x00, 0x00, 0x80, 0x00, 0x00, 0x00, 0x00, 0x00, 0x00, 0x00, 0x00, 0x00,
0x00, 0x00, 0x00, 0x00, 0x00, 0x04, 0x80, 0x00, 0x00, 0x00, 0x00, 0x00, 0x00, 0x00, 0x00, 0x00,
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0x00, 0x00, 0x00, 0x60, 0xcf, 0xd8, 0x31, 0xf8, 0x3e, 0x61, 0x9f, 0xd8, 0x30, 0x00, 0x00, 0x00};


  
Adafruit_SH1107 display = Adafruit_SH1107(64, 128,OLED_MOSI, OLED_CLK, OLED_DC, OLED_RESET, OLED_CS);


void setup() {

  Serial.begin(9600);
  Serial.println("START");
  pinMode(HEATER,OUTPUT);
  pinMode(PUMP,OUTPUT);
  pinMode(5,OUTPUT);
  pinMode(6,OUTPUT);
  pinMode(BUZZER,OUTPUT);
  digitalWrite(HEATER,HIGH);
  digitalWrite(PUMP,HIGH);


  // Start OLED
  display.begin(0, true); // we dont use the i2c address but we will reset!
  display.clearDisplay();
  display.setRotation(3);
  display.setTextSize(1);
  display.setTextColor(SH110X_WHITE);
  display.setCursor(0,0);
  display.drawBitmap(0, 0, filmochem_bmp, 128, 64, SH110X_WHITE); // display.drawBitmap(x position, y position, bitmap data, bitmap width, bitmap height, color);
  display.display();
  
  
  delay(5000);
  displayProcess("   C-41");
  curMenu = 1;


}

void displayCurrentStatus(){
  display.clearDisplay();
  display.setCursor(0,0);
  
  if(!reverse && i<110){
    i=i+10;
  }
  else if(reverse && i<=110){
    i=i-10;
  }
  if(i == 110){
    reverse = true;
  }
  else if(i == 0){
    reverse = false;
  }
  
  if(waterTemp == -127){
    display.setTextSize(2);
    display.print("WATER \nSENSOR \nERROR!");
    display.invertDisplay(1);
    digitalWrite(5,LOW);
    digitalWrite(6,LOW);
    tone(BUZZER,900,100);
    delay(200);
    display.invertDisplay(0);
    digitalWrite(5,HIGH);
    digitalWrite(6,HIGH);
    tone(BUZZER,700,100);
  }
  else{
    display.setTextSize(1);
    display.print("--- Sensor values ---\n\nWater  temp:  ");
    display.print(waterTemp);
    display.print(" C \nChem A temp:  ");
    display.print(chemATemp);
    display.print(" C \nChem B temp:  ");
    display.print(chemBTemp);
    display.print(" C");
    display.setCursor(i,58);
    display.println("---");
  }
   display.display();

  
}
void displayProcess(char* process){
  display.clearDisplay();
  display.setCursor(0,0);
  display.setTextSize(1);
  display.println("Sel. process UP/DOWN\n\n");
  display.setTextSize(2);
  display.println(process);
  display.display();

  
}


void startWaterBath(int targetTemp){
  //tone(BUZZER,800,150);
  digitalWrite(5,HIGH);
  digitalWrite(PUMP,LOW);
  while(true){
      delay(500);
      sensors.requestTemperatures(); 
      waterTemp = sensors.getTempC(sensor3);
      chemATemp = sensors.getTempC(sensor1);
      chemBTemp = sensors.getTempC(sensor2);
      displayCurrentStatus();

      if(waterTemp!=-127 && (waterTemp < targetTemp - maxTempVariation)){
        digitalWrite(HEATER,LOW);
        digitalWrite(6,HIGH);
      }
  
      else if (waterTemp > targetTemp + maxTempVariation)
      {
        digitalWrite(HEATER,HIGH);
        digitalWrite(6,LOW);
      }
  }
}



void loop() {
  delay(100);
  int value = analogRead(A0);
  
  //down 239-249
  //up 415-425
  //left 695-705
  //right 814-824;
  //center 1010-1024


  if(value>239 && value<249){ //down
    if(curMenu==1) {
      displayProcess("   E-6");
      curMenu = 2;
      return;
    }
    displayProcess("   C-41");
    curMenu = 1;
    
  }
  
  else if(value>415 && value<425){ //up
    if(curMenu==1) {
      displayProcess("   E-6");
      curMenu = 2;
      return;
    }
    
    displayProcess("   C-41");
    curMenu = 1;
    
  }

  

   if(value>1010 && value<1024 && curMenu==1){ //center
    display.invertDisplay(1);
    delay(300);
    display.invertDisplay(0);
    startWaterBath(39);
    }

    
  

}
